#include "totem.dtsi"

/ {
    mock_kscan: mock_kscan {
        compatible = "zmk,kscan-mock";
        columns = <0>;
        rows = <0>;
        events = <0>;
    };
    &default_layout {
        kscan = <&mock_kscan>;
    };
};

