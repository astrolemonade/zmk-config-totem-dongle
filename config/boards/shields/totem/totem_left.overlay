#include "totem.dtsi"
#include "fastbatcharge.dtsi"

&kscan0 {
    compatible = "zmk,kscan-gpio-matrix";
    label = "LEFT_KSCAN";
    col-gpios
        = <&xiao_d 4 GPIO_ACTIVE_HIGH>
        , <&xiao_d 5 GPIO_ACTIVE_HIGH>
        , <&xiao_d 10 GPIO_ACTIVE_HIGH>
        , <&xiao_d 9 GPIO_ACTIVE_HIGH>
        , <&xiao_d 8 GPIO_ACTIVE_HIGH>
        ;
};
