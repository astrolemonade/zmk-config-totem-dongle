## config/west.yml
```yaml
manifest:
  remotes:
    - name: astrolemonade
      url-base: https://github.com/astrolemonade
  projects:
    - name: zmk
      remote: astrolemonade
      revision: main
      import: app/west.yml
    - name: zmk-dongle-display-091-oled 
      remote: astrolemonade
      revision: main
  self:
    path: config
```
